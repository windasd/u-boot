## arch/arm/mach-owl/Kconfig
```kconfig
if ARCH_OWL

choice
	prompt "Actions Semi Owl SoC Variant"
        optional

config MACH_S900
	bool "Actions Semi S900 SoC"
	select ARM64

config MACH_S700
	bool "Actions Semi S700 SoC"
	select ARM64

endchoice

config TEXT_BASE
	default 0x11000000

config SYS_CONFIG_NAME
        default "owl-common"

# Only used to find board/actions/bubblegum_96/bubblegum_96.env
config SYS_VENDOR
	default "actions" if MACH_S900

config SYS_BOARD
	default "bubblegum_96" if MACH_S900

config SYS_SOC
        default "s900" if MACH_S900
        default "s700" if MACH_S700

endif
```

## configs/bubblegum_96_defconfig
```kconfig
CONFIG_ARM=y
CONFIG_COUNTER_FREQUENCY=24000000
CONFIG_INIT_SP_RELATIVE=y
CONFIG_ARCH_OWL=y
CONFIG_SYS_MALLOC_LEN=0x2000000
CONFIG_ENV_SIZE=0x2000
CONFIG_DEFAULT_DEVICE_TREE="bubblegum_96"
CONFIG_MACH_S900=y
CONFIG_DM_RESET=y
CONFIG_SYS_BOOTM_LEN=0x4000000
CONFIG_SYS_LOAD_ADDR=0x7ffc0
CONFIG_IDENT_STRING="\nBubblegum-96"
CONFIG_BOOTSTD_DEFAULTS=y
CONFIG_DISTRO_DEFAULTS=y
CONFIG_BOOTDELAY=1
CONFIG_OF_BOARD_SETUP=y
CONFIG_USE_BOOTARGS=y
CONFIG_BOOTARGS="console=ttyOWL5,115200n8"
CONFIG_BOOTCOMMAND="load mmc 1:2 ${scriptaddr} boot.scr && source ${scriptaddr}; echo bg96: boot.scr failed, trying rescue.scr on p5; load mmc 1:5 ${scriptaddr} rescue.scr && source ${scriptaddr}"
CONFIG_SYS_PBSIZE=1051
# CONFIG_DISPLAY_CPUINFO is not set
# CONFIG_DISPLAY_BOARDINFO is not set
CONFIG_SYS_PROMPT="U-Boot => "
CONFIG_CMD_MD5SUM=y
CONFIG_CMD_MEMINFO=y
CONFIG_CMD_GPT=y
CONFIG_CMD_I2C=y
CONFIG_CMD_MMC=y
CONFIG_CMD_POWEROFF=y
CONFIG_CMD_CACHE=y
# CONFIG_CMD_CLS is not set
CONFIG_CMD_TIMER=y
CONFIG_DM_I2C=y
CONFIG_SYS_I2C_OWL=y
CONFIG_MMC_OWL=y
CONFIG_VIDEO=y
# CONFIG_BACKLIGHT is not set
CONFIG_VIDEO_DAMAGE=y
# CONFIG_VIDEO_BPP8 is not set
# CONFIG_VIDEO_BPP16 is not set
CONFIG_SYS_WHITE_ON_BLACK=y
# CONFIG_PANEL is not set
CONFIG_VIDEO_OWL_S900=y
```

## drivers/video/owl/Kconfig
```kconfig
config VIDEO_OWL_S900
	bool "Actions Semi S900 display engine with HDMI output"
	depends on VIDEO && MACH_S900 && CLK && DM_RESET && OF_LIBFDT
	help
	  Drives the S900 display engine path 0 into the HDMI transmitter
	  at a 1080p or 720p CEA mode, scanning out a 1920x1080 XRGB8888
	  framebuffer at 0x19000000 that the display engine scales to the
	  output, as the vendor U-Boot 2015.07 does. With DM_I2C the mode
	  is the best one the sink's EDID lists, read over the I2C bus the
	  display node's ddc-i2c-bus names; the bg96_hdmi_mode environment
	  variable can name one instead, and bg96_hdmi selects auto, force
	  or off. The board's ft_board_setup() hands the framebuffer to the
	  OS as a simple-framebuffer.
```
